## conf/distro/falcon-tiny.conf
```bitbake
# Use O.S. Systems Embedded Linux as base
require conf/distro/oel-tiny.conf

### Specific settings

DISTRO = "falcon-tiny"
DISTRO_NAME = "Peregrine Falcon Platform Tiny"
SDK_VENDOR = "-falconsdk"
SDK_VERSION := "${@'${DISTRO_VERSION}'.replace('snapshot-${DATE}','snapshot')}"

TARGET_VENDOR = "-falcon"

TCLIBC = "glibc"

FALCON_TINY_DEFAULT_DISTRO_FEATURES = "\
    argp \
    ext2 \
    ipsec \
    largefile \
    nfs \
    pam \
    usbgadget \
    usbhost \
    wifi \
    xattr \
    sysvinit \
"

DISTRO_FEATURES = "\
    ${FALCON_TINY_DEFAULT_DISTRO_FEATURES} \
"

DISTRO_FEATURES_BACKFILL_CONSIDERED = "\
    pulseaudio \
    glibc-locale \
    python \
"

# To easy the upgrade for morty-based system, the GCC has been fixed
# for 6.x based release.
GCCVERSION = "6.%"
```

## conf/distro/falcon.conf
```bitbake
# Use O.S. Systems Embedded Linux as base
require conf/distro/oel.conf

### Specific settings

DISTRO = "falcon"
DISTRO_NAME = "Peregrine Falcon Platform"
SDK_VENDOR = "-falconsdk"
SDK_VERSION := "${@'${DISTRO_VERSION}'.replace('snapshot-${DATE}','snapshot')}"

TARGET_VENDOR = "-falcon"
QEMU_TARGETS = "arm aarch64 i386 x86_64 ppc ppc64"

# Valgrind Options
PTEST_ENABLED_pn-valgrind = "0"

# intramfs instructions
INITRAMFS_IMAGE = "falcon-image-initramfs"
INITRAMFS_IMAGE_BUNDLE ?= "1"
INITRAMFS_MAXSIZE = "262144"
INITRAMFS_FSTYPES ?= "cpio.gz"

# live image instructions
INITRD_IMAGE_LIVE = "${INITRAMFS_IMAGE}"

# WIC instructions
WKS_FILE = "falcon-image.wks"

# Default Mono version
PREFERRED_VERSION_mono = "4.2.3.4"
PREFERRED_VERSION_mono-native = "4.2.3.4"

# Default NGINX version
PREFERRED_VERSION_nginx = "1.11.5"

# Default init system
VIRTUAL-RUNTIME_init_manager = "systemd"
VIRTUAL-RUNTIME_initscripts = ""

# Default net-snmp manager
VIRTUAL-RUNTIME_snmp-manager = "net-snmp-server"

# zeroconf is necessary to enable avahi
FALCON_DEFAULT_DISTRO_FEATURES = "\
    argp \
    ext2 \
    largefile \
    nfs \
    ptest \
    usbgadget \
    usbhost \
    wifi \
    xattr \
    ipsec \
    pam \
    systemd \
    snmp \
    pci \
    ${@bb.utils.contains('MACHINE_FEATURES', 'falcon-cpe falcon-nas', 'zeroconf', '',d)} \
    ${@bb.utils.contains('MACHINE_FEATURES', 'falcon-virt', 'virtualization', '',d)} \
"

DISTRO_FEATURES = "\
    ${DISTRO_FEATURES_LIBC} \
    ${FALCON_DEFAULT_DISTRO_FEATURES} \
"

DISTRO_FEATURES_BACKFILL_CONSIDERED = "\
    pulseaudio \
    sysvinit \
"

BAD_RECOMMENDATIONS += "busybox busybox-syslog busybox-udhcpc"

# Default TIMEZONE & LOCALE
GLIBC_GENERATE_LOCALES = "\
    en_US en_US.UTF-8 \
    en_GB en_GB.UTF-8 \
    pt_BR pt_BR.UTF-8 \
    pt_PT pt_PT.UTF-8 \
    es_ES es_ES.UTF-8 \
    es_AR es_AR.UTF-8 \
    es_MX es_MX.UTF-8 \
"

IMAGE_LINGUAS = "\
    en-us \
    en-gb \
    pt-br \
    es-es \
    es-ar \
    es-mx \
"

DEFAULT_TIMEZONE="America/Sao_Paulo"

# Default licenses whitelist
LICENSE_FLAGS_WHITELIST = "commercial_ffmpeg commercial_x264"

# To easy the upgrade for morty-based system, the GCC has been fixed
# for 6.x based release.
GCCVERSION = "6.%"
```

## conf/machine/comex.conf
```bitbake
#@TYPE: Machine
#@NAME: comex
#@WEBTITLE: Computer Module Express based on Intel Atom E38xx/E39xx Processor 64-bit
#@DESCRIPTION: Machine configuration for COM-Express 64-bit systems with focus on Intel Atom
#E38xx/E39xx processor, formerly Silvermont/Apollo Lake processors.

DEFAULTTUNE ?= "corei7-64"

PREFERRED_PROVIDER_virtual/bootloader = ""

PREFERRED_PROVIDER_virtual/kernel ?= "linux-yocto"
PREFERRED_VERSION_linux-yocto ?= "4.8%"

require conf/machine/include/intel-corei7-64-common.inc
require conf/machine/include/intel-common-pkgarch.inc
require conf/machine/include/meta-intel.inc

MACHINE_FEATURES += "pcbios efi"
MACHINE_FEATURES += "intel-ucode"
MACHINE_FEATURES += "ext2 vfat pci usbhost sdio serial"
MACHINE_FEATURES += "falcon-pbx falcon-virt falcon-docker"

#MACHINE_EXTRA_RRECOMMENDS += "linux-firmware"
MACHINE_EXTRA_RRECOMMENDS += "lms8"

#SYSLINUX_OPTS = "serial 0 115200"
#SERIAL_CONSOLE = "115200 ttyS0"
APPEND += "acpi_enforce_resources=lax video=efifb:off console=ttyS0,115200 console=tty0"

PACKAGE_INSTALL_append_pn-falcon-image = " networkmanager"
```

## recipes-falcon/images/falcon-image.wks
```
# short-description: FALCON base partition layout
# long-description: This image contains boot partition and 4 partitions
# created from falcon-image recipe.

part /boot/golden --ondisk mmcblk --label golden --align 1024 --fstype=ext4 --size 512M  --source bootimg-partition
part /            --ondisk mmcblk --label rootfs --align 1024 --fstype=ext4 --source rootfs

bootloader --ptable gpt
```
